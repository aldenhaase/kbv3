## app/dts/bindings/kbv3,keys.yaml
```yaml
description: Generic GPIO configuration

compatible: "kbv3-keys"

child-binding:
  properties:
     gpios:
        type: phandle-array
        required: true
```

## app/dts/bindings/ti,tca8418.yaml
```yaml
description: Texas Instruments TCA8418 keypad encoder

compatible: "ti,tca8418"

include: i2c-device.yaml

properties:
  gpios:
    type: phandle-array
    required: true
```
