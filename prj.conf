## CMakeLists.txt
```
cmake_minimum_required(VERSION 3.13.1)


set(BOARD_ROOT $ENV{ENVR_ROOT}/app)
set(DTS_ROOT $ENV{ENVR_ROOT}/app)

find_package(Zephyr $ENV{PROJECT_ZEPHYR_VERSION} EXACT REQUIRED HINTS $ENV{ZEPHYR_BASE})

project(app)

add_subdirectory(app)

target_include_directories(app PRIVATE ${CMAKE_SOURCE_DIR}/app/boards/common)


# Add stricter warnings
# Note that this applies to the library AND application source - do not enable warnings
# that will be generated by library source
target_compile_options(app
    PRIVATE
    -Wall  # default

    # -Wextra  # but disable some noisy ones that will generate warnings in library source
    -Wno-unused-parameter
    -Wno-sign-compare
    -Wno-missing-braces
    -Wdouble-promotion  # detect potential use of software-doubles instead of hardware-floats
)
```

## prj.conf
```kconfig
CONFIG_GPIO=y

CONFIG_USB_DEVICE_STACK=y
CONFIG_USB_DEVICE_PID=0x0110
CONFIG_USB_DEVICE_PRODUCT="KBv3"
CONFIG_USB_CDC_ACM=y
CONFIG_USB_DEVICE_HID=y

CONFIG_UART_INTERRUPT_DRIVEN=y 

CONFIG_SHELL=y
CONFIG_LOG=y
CONFIG_SHELL_LOG_BACKEND=y
CONFIG_SERIAL=y
CONFIG_I2C=y

CONFIG_ASSERT=y
```

## src/startup.c
```c
#include <stdint.h>

#define SRAM_START (0x20000000U)
#define SRAM_SIZE (32U * 1024U)
#define SRAM_END (SRAM_START + SRAM_SIZE)
#define STACK_POINTER_INIT_ADDRESS (SRAM_END)

#define ISR_VECTOR_SIZE_WORDS 114

void reset_handler(void);
void default_handler(void);
void nmi_handler(void) __attribute__((weak, alias("default_handler")));
void hard_fault_handler(void) __attribute__((weak, alias("default_handler")));
void svcall_handler(void) __attribute__((weak, alias("default_handler")));
void pendsv_handler(void) __attribute__((weak, alias("default_handler")));
void systick_handler(void) __attribute__((weak, alias("default_handler")));
// continue adding device interrupt handlers


extern uint32_t _etext, _sdata, _edata, _sbss, _ebss;
int main(void);

void reset_handler(void)
{
  // Copy .data from FLASH to SRAM
  uint32_t data_size = (uint32_t)&_edata - (uint32_t)&_sdata;
  uint8_t *flash_data = (uint8_t*) &_etext;
  uint8_t *sram_data = (uint8_t*) &_sdata;
  
  for (uint32_t i = 0; i < data_size; i++)
  {
    sram_data[i] = flash_data[i];
  }

  // Zero-fill .bss section in SRAM
  uint32_t bss_size = (uint32_t)&_ebss - (uint32_t)&_sbss;
  uint8_t *bss = (uint8_t*) &_sbss;

  for (uint32_t i = 0; i < bss_size; i++)
  {
    bss[i] = 0;
  }
  
  main();
}

void default_handler(void)
{
  while(1);
}

uint32_t isr_vector[ISR_VECTOR_SIZE_WORDS] __attribute__((section(".isr_vector"))) = {
    STACK_POINTER_INIT_ADDRESS,
    (uint32_t)&reset_handler,
    (uint32_t)&nmi_handler,
    (uint32_t)&hard_fault_handler,
    0,
    0,
    0,
    0,
    0,
    0,
    0,
    (uint32_t)&svcall_handler,
    0,
    0,
    (uint32_t)&pendsv_handler,
    (uint32_t)&systick_handler,
    // continue adding device interrupt handlers
};
```
